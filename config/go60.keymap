/*
 * Copyright (c) 2020 The ZMK Contributors
 *
 * SPDX-License-Identifier: MIT
 */

#include <behaviors.dtsi>

#include <dt-bindings/zmk/bt.h>
#include <dt-bindings/zmk/ext_power.h>
#include <dt-bindings/zmk/keys.h>
#include <dt-bindings/zmk/outputs.h>
#include <dt-bindings/zmk/rgb.h>
#include <dt-bindings/zmk/input_transform.h>
#include <dt-bindings/zmk/pointing.h>

#include <input/processors.dtsi>
#include <zephyr/dt-bindings/input/input-event-codes.h>
#include "zmk-helpers/helper.h"
#include "definitions/keypos_go60.dtsi"
#include "definitions/helpers.dtsi"


#define XXX &none
#define ___ &trans 

// layers
#define LAYER_Base 0
#define LAYER_Sturdy 1
#define LAYER_Game 2
#define NUM 3
#define NUM_TMP 4
#define NUM_LCK 5
#define NAV 6
#define NAV_TMP 7
#define NAV_LCK 8
#define SYM 9
#define ALLWAYS 10
#define LAYER_Magic 1
#define LAYER_Factory 12

/* Left-hand HRMs. */
ZMK_HOLD_TAP(hml,
    flavor = "balanced";
    tapping-term-ms = <280>;
    quick-tap-ms = <175>;
    require-prior-idle-ms = <150>;
    bindings = <&kp>, <&kp>;
    hold-trigger-key-positions = <RIGHT_HAND_KEYS THUMB_KEYS>;
    hold-trigger-on-release;
)

/* Right-hand HRMs. */
ZMK_HOLD_TAP(hmr,
    flavor = "balanced";
    tapping-term-ms = <280>;
    quick-tap-ms = <175>;
    require-prior-idle-ms = <150>;
    bindings = <&kp>, <&kp>;
    hold-trigger-key-positions = <LEFT_HAND_KEYS THUMB_KEYS>;
    hold-trigger-on-release;
) 
ZMK_HOLD_TAP(hll,
    flavor = "balanced";
    tapping-term-ms = <280>;
    quick-tap-ms = <175>;
    require-prior-idle-ms = <150>;
    bindings = <&mo>, <&kp>;
    hold-trigger-key-positions = <RIGHT_HAND_KEYS THUMB_KEYS>;
    hold-trigger-on-release;
)

ZMK_HOLD_TAP(hlr,
    flavor = "balanced";
    tapping-term-ms = <280>;
    quick-tap-ms = <175>;
    require-prior-idle-ms = <150>;
    bindings = <&mo>, <&kp>;
    hold-trigger-key-positions = <LEFT_HAND_KEYS THUMB_KEYS>;
    hold-trigger-on-release;
) 


#define QUICK_TAP_MS 175

&sk {
  release-after-ms = <900>;
  quick-release;
};

&sl { // Allow sticky mods to chord across sticky layers.
  ignore-modifiers;
};

&lt {
  flavor = "balanced";
  tapping-term-ms = <200>;
  quick-tap-ms = <QUICK_TAP_MS>;
};



// Trigger tap-action on all interrupts.
#define MT_CORE                                                                \
  flavor = "tap-preferred";                                                    \
  tapping-term-ms = <220>;                                                     \
  quick-tap-ms = <220>;                                                        \
  hold-trigger-key-positions = <0>;

&mt { MT_CORE };


#define ARROW &arrow 0 0

// define home row keys and nav space
#define NAV_SPACE &lt NAV SPACE
#define R_ALL &lt ALLWAYS R
#define LOCK_NAV &tog NAV_LCK
#define LOCK_NUM &tog NUM_LCK

//

// left
#define HML_S &hml RALT S
#define HML_R &hll SYM R
#define HML_N &kp N
#define HML_T &hll NAV_TMP T 

#define HML_J &hml LSFT J
#define HML_X &hml LCTL X
#define HML_B &hml LALT B
#define HML_K &hml LGUI K 
//right
#define HMR_C &hlr NUM_TMP C
#define HMR_E &kp E 
#define HMR_I &hlr SYM I
#define HMR_A &hmr RALT A

#define HMR_P     &hmr RGUI P
#define HMR_COMMA &hmr LALT COMMA
#define HMR_DOT   &hmr RCTL DOT
#define HMR_SLASH &hmr RSFT SLASH

#define S_ALLWAYS &lt ALLWAYS S

#include "combos.dtsi"

// Define mod-morph with a *single* mod trigger for less repetition.
#define SIMPLE_MORPH(NAME, MOD, BINDING1, BINDING2)                            \
  ZMK_MOD_MORPH(NAME, mods = <(MOD_L##MOD | MOD_R##MOD)>;                      \
                bindings = <BINDING1>, <BINDING2>;)

SIMPLE_MORPH(dot_collon, SFT, &kp DOT,   &kp COLON)
SIMPLE_MORPH(comma_scln, SFT, &kp COMMA, &kp SCLN)

// tap: copy | double-tap: cut
ZMK_TAP_DANCE(copy_cut,
    tapping-term-ms = <200>;
    bindings = <&kp LC(INS)>, <&kp LC(X)>;
)




&caps_word {
    continue-list = <UNDERSCORE MINUS>;
};

/ {
     conditional_layers {
        compatible = "zmk,conditional-layers";
        nav_temp {
            if-layers = <NAV_TMP>;
            then-layer = <NAV>;
        };
        nav_lock {
            if-layers = <NAV_LCK>;
            then-layer = <NAV>;
        };
        num_temp {
            if-layers = <NUM_TMP>;
            then-layer = <NUM>;
        };
        num_lock {
            if-layers = <NUM_LCK>;
            then-layer = <NUM>;
        };
    };

    combos {
        compatible = "zmk,combos";

        // cmb_enter
        combo_cmb_enter {
            key-positions = <POS_RH_C2R3 POS_RH_C3R3 POS_RH_C4R3>;
            bindings = <&kp RET>;
        };

        // cmb_oe
        combo_cmb_oe {
             timeout-ms = <35>;
            key-positions = <POS_RH_C2R2 POS_RH_C3R2>;
            bindings = <&oe>;
        };

        // cmb_ue
        combo_cmb_ue {
            key-positions = <POS_RH_C2R2 POS_RH_C4R2>;
            timeout-ms = <35>;
            bindings = <&ue>;
        };
        combo_cmb_ae {
            key-positions = <POS_RH_C2R3 POS_RH_C4R3>;
            bindings = <&ae>;
            timeout-ms = <35>;
        };
        combo_cmb_sz {
            key-positions = <POS_LH_C5R3 POS_LH_C4R3>;
            bindings = <&sz>;
            timeout-ms = <35>;
        };
        combo_cmb_v{
            key-positions = <POS_LH_C5R2 POS_LH_C4R2>;
            bindings = <&kp V>;
            timeout-ms = <35>;
        };

        combo_cmb_delete {
            key-positions = <POS_LH_C2R3 POS_LH_C1R3>;
            bindings = <&kp DEL>;
            timeout-ms = <35>;
        };
        combo_cmb_backspace{
            key-positions = <POS_RH_C2R3 POS_RH_C1R3>;
            bindings = <&kp BACKSPACE>;
            timeout-ms = <35>;
        };
    };
};

/ {
    input_processors {
        zip_click_to_right_click_mapper: zip_click_to_right_click_mapper {
            compatible = "zmk,input-processor-code-mapper";
            #input-processor-cells = <0>;
            type = <INPUT_EV_KEY>;
            map = <INPUT_BTN_0 INPUT_BTN_1>;
        };
    };

    behaviors {
        swapper: swapper {
            compatible = "zmk,behavior-tri-state";
            #binding-cells = <0>;
            bindings = <&kt LALT>, <&kp TAB>, <&kt LALT>;
        };

        skq: sticky_key_quick_release {
            compatible = "zmk,behavior-sticky-key";
            #binding-cells = <1>;
            bindings = <&kp>;
            release-after-ms = <1000>;
            quick-release;
            ignore-modifiers;
        };
           
        shifted: macro_shifted_kp {
            #binding-cells = <1>;
            label = "MACRO_SHIFTED_KP";
            compatible = "zmk,behavior-macro-one-param";
            bindings =
              <&macro_press &kp LSHFT>,
              <&macro_param_1to1 &macro_tap &kp MACRO_PLACEHOLDER>,
              <&macro_release &kp LSHFT>;
        };

        as_ht: autoshift_hold_tap {
            compatible = "zmk,behavior-hold-tap";
            label = "AUTOSHIFT_HOLD_TAP";
            #binding-cells = <2>;
            tapping-term-ms = <195>;
            flavor = "tap-preferred";
            bindings = <&shifted>, <&kp>;
        };

        as: autoshift {
            compatible = "zmk,behavior-macro-one-param";
            #binding-cells = <1>;
            label = "AUTOSHIFT_KP";
            bindings =
              <&macro_press>,
              <&macro_param_1to1>,
              <&macro_param_1to2>,
              <&as_ht MACRO_PLACEHOLDER MACRO_PLACEHOLDER>,
              <&macro_pause_for_release>,
              <&macro_release>,
              <&macro_param_1to1>,
              <&macro_param_1to2>,
              <&as_ht MACRO_PLACEHOLDER MACRO_PLACEHOLDER>;
        };
        
        arcane: arcane {
             compatible = "zmk,behavior-adaptive-key";
             #binding-cells = <0>;
             bindings = <&skq LSFT>;
             arc_eo { trigger-keys = <E>; max-prior-idle-ms = <500>; bindings = <&kp O>; };
             arc_yp { trigger-keys = <Y>; max-prior-idle-ms = <500>; bindings = <&kp P>; };
             arc_au { trigger-keys = <A>; max-prior-idle-ms = <500>; bindings = <&kp U>; };
             arc_rl { trigger-keys = <R>; max-prior-idle-ms = <500>; bindings = <&kp L>; };
             arc_kt { trigger-keys = <K>; max-prior-idle-ms = <500>; bindings = <&kp T>; };
             arc_dt { trigger-keys = <D>; max-prior-idle-ms = <500>; bindings = <&kp T>; };
             arc_zw { trigger-keys = <Z>; max-prior-idle-ms = <500>; bindings = <&kp W>; }; // todo - better ff?
             arc_fr { trigger-keys = <F>; max-prior-idle-ms = <500>; bindings = <&kp R>; }; // todo - better ff?
             arc_include{ trigger-keys = <HASH>; max-prior-idle-ms = <500>; bindings = <&minclude>; }; // todo - better ff?

             arc_vim { trigger-keys = <ESC>; max-prior-idle-ms = <500>; bindings = <&kp COLON>; };
        };

        magic_st: magic_s{
             compatible = "zmk,behavior-adaptive-key";
             #binding-cells = <0>;
             bindings = <&kp N>;
             arc_ue { trigger-keys = <E>; max-prior-idle-ms = <500>; bindings = <&kp U>; };
             arc_au { trigger-keys = <A>; max-prior-idle-ms = <500>; bindings = <&kp U>; };
             arc_rl { trigger-keys = <R>; max-prior-idle-ms = <500>; bindings = <&kp L>; };
             arc_kt { trigger-keys = <K>; max-prior-idle-ms = <500>; bindings = <&kp T>; };
             arc_dt { trigger-keys = <D>; max-prior-idle-ms = <500>; bindings = <&kp T>; };
             arc_mt { trigger-keys = <T>; max-prior-idle-ms = <500>; bindings = <&kp M>; }; // todo - better ff?
             arc_vim { trigger-keys = <ESC>; max-prior-idle-ms = <500>; bindings = <&kp COLON>; };
        };

        magic: magic {
            compatible = "zmk,behavior-hold-tap";
            #binding-cells = <2>;
            flavor = "tap-preferred";
            tapping-term-ms = <200>;
            bindings = <&mo>, <&rgb_ug_status_macro>;
        };


        bt_0: bt_0 {
            compatible = "zmk,behavior-tap-dance";
            #binding-cells = <0>;
            tapping-term-ms = <200>;
            bindings = <&bt_select_0>, <&bt BT_DISC 0>;
        };
        bt_1: bt_1 {
            compatible = "zmk,behavior-tap-dance";
            #binding-cells = <0>;
            tapping-term-ms = <200>;
            bindings = <&bt_select_1>, <&bt BT_DISC 1>;
        };
        bt_2: bt_2 {
            compatible = "zmk,behavior-tap-dance";
            #binding-cells = <0>;
            tapping-term-ms = <200>;
            bindings = <&bt_select_2>, <&bt BT_DISC 2>;
        };
        bt_3: bt_3 {
            compatible = "zmk,behavior-tap-dance";
            #binding-cells = <0>;
            tapping-term-ms = <200>;
            bindings = <&bt_select_3>, <&bt BT_DISC 3>;
        };
    };

    macros {
        rgb_ug_status_macro: rgb_ug_status_macro {
            compatible = "zmk,behavior-macro";
            #binding-cells = <0>;
            bindings = <&rgb_ug RGB_STATUS>;
        };

        bt_select_0: bt_select_0 {
            compatible = "zmk,behavior-macro";
            #binding-cells = <0>;
            bindings
                = <&out OUT_BLE>,
                  <&bt BT_SEL 0>;
        };
        bt_select_1: bt_select_1 {
            compatible = "zmk,behavior-macro";
            #binding-cells = <0>;
            bindings
                = <&out OUT_BLE>,
                  <&bt BT_SEL 1>;
        };
        bt_select_2: bt_select_2 {
            compatible = "zmk,behavior-macro";
            #binding-cells = <0>;
            bindings
                = <&out OUT_BLE>,
                  <&bt BT_SEL 2>;
        };
        bt_select_3: bt_select_3 {
            compatible = "zmk,behavior-macro";
            #binding-cells = <0>;
            bindings
                = <&out OUT_BLE>,
                  <&bt BT_SEL 3>;
        };
                // oe
        oe: oe {
            label = "&OE";
            compatible = "zmk,behavior-macro";
            #binding-cells = <0>;
            bindings = <&kt RALT>
                , <&kp O>
                , <&kt RALT>;
        };

        // ae
        ae: ae {
            label = "&AE";
            compatible = "zmk,behavior-macro";
            #binding-cells = <0>;
            bindings = <&sk RALT>
                , <&kp A>;
        };

        // ue
        ue: ue {
            label = "&UE";
            compatible = "zmk,behavior-macro";
            #binding-cells = <0>;
            bindings = <&sk RALT>
                , <&kp U>;
        };

        // sz
        sz: sz {
            label = "&SZ";
            compatible = "zmk,behavior-macro";
            #binding-cells = <0>;
            bindings = <&sk RALT>
                , <&kp S>;
        };

        tarrow: tarrow{
            label = "&TARROW";
            compatible = "zmk,behavior-macro";
            #binding-cells = <0>;
            bindings = <&kp MINUS>
                , <&kp GT>;
        };
        farrow: fawwow {
            label = "&FARROW";
            compatible = "zmk,behavior-macro";
            #binding-cells = <0>;
            bindings = <&kp EQUAL>
                , <&kp GT>;
        };

        arrow: mod_tap {
            compatible = "zmk,behavior-hold-tap";
            #binding-cells = <2>;
            flavor = "hold-preferred";
            tapping-term-ms = <200>;
            bindings = <&farrow>, <&tarrow>;
            display-name = "Arrow";
        };
        
        overview: overview {
            label = "magic include";
            compatible = "zmk,behavior-macro";
            #binding-cells = <0>;
            bindings = 
                 <&kt LGUI>
                , <&kp O>
                , <&kt LGUI>;
        };
        minclude: minclude {
            label = "magic include";
            compatible = "zmk,behavior-macro";
            #binding-cells = <0>;
            bindings = 
                 <&kp I>
                , <&kp N>
                , <&kp C>
                , <&kp L>
                , <&kp U>
                , <&kp D>
                , <&kp E>;
        };
    };

    keymap {
        compatible = "zmk,keymap";
        layer_Base {
            bindings = <
            &kp EQUAL  &kp N1     &kp N2   &kp N3    &kp N4  &kp N5                                                       &kp N6     &kp N7      &kp N8     &kp N9     &kp N0  &to LAYER_Sturdy
              &kp TAB   &kp F      &kp L    &kp H     &kp D   &kp V                                                           &kp W   &kp G       &kp O      &kp U    &kp SQT        &kp BSLH
            &skq LSFT   HML_S      HML_R    HML_N     HML_T   &kp M                                                           &kp Y   HMR_C       HMR_E      HMR_I      HMR_A        &skq RSFT
 &magic LAYER_Magic 0   HML_J      HML_X    HML_B     HML_K   &kp Q                                                           &kp Z   HMR_P   HMR_COMMA    HMR_DOT  HMR_SLASH           &kp N1
                               &kp END &kp LEFT  &kp RIGHT                                                                           &kp UP    &kp DOWN  &kp HOME
                                                      NAV_SPACE   &skq LCTL &skq LALT                          &skq LGUI  &skq RALT &arcane
            >;
        };

        layer_Norden {
            bindings = <
            &kp EQUAL        &kp N1       &kp N2       &kp N3       &kp N4  &kp N5                                                       &kp N6      &kp N7           &kp N8          &kp N9           &kp N0    &to 2
              &kp TAB         &kp Q        &kp L        &kp D        &kp Z   &kp V                                                       &kp P        &kp W            &kp O           &kp U          &kp SQT     &kp BSLH
            &skq LSFT   &hml LSFT R   &hll SYM N  &hml LSFT T   &hll NAV_TMP H   &kp F                                                       &kp Y   &hlr NUM_TMP C      &hml LSFT E      &hlr SYM I      &hmr RSFT A     &skq RSFT
 &magic LAYER_Magic 0   &hml LSFT X  &hml LCTL J  &hml LALT M  &hml LGUI B   &kp K                                                    &kp SCLN  &hmr RGUI G  &hmr LALT COMMA   &hmr LCTL DOT  &hmr RSFT SLASH   &kp N1
                            &kp END     &kp LEFT    &kp RIGHT                                                                           &kp UP    &kp DOWN          &kp HOME
                                                    S_ALLWAYS  &sl NUM   &skq LALT                          &skq LGUI  &kp UNDER NAV_SPACE
            >;
        };

        layer_NordenAs {
            bindings = <
            &kp EQUAL        &kp N1       &kp N2       &kp N3       &kp N4  &kp N5                                                       &kp N6      &kp N7           &kp N8          &kp N9           &kp N0    &to 0
              &kp TAB         &kp V        &kp M        &kp L        &kp C   &kp P                                                       &kp X       &arcane           &kp O           &kp U           &kp Q     &kp BSLH
            &skq LSFT   &hml LALT S   &hll SYM T  &hml LSFT N   &hll NAV D   &kp Y                                                       &kp B   &hlr NUM H      &hmr LSFT E      &hlr SYM I      &hmr LALT A     &skq RSFT
 &magic LAYER_Magic 0   &hml LSFT Z  &hml LCTL K  &hml LALT J  &hml LGUI G   &kp W                                                     &kp SQT  &hmr RGUI F  &hmr LALT COMMA   &hmr LCTL DOT  &hmr RSFT SLASH   &kp N1
                            &kp END     &kp LEFT    &kp RIGHT                                                                           &kp UP    &kp DOWN          &kp HOME
                                                        R_ALL  &sl NUM   &skq LALT                          &skq LGUI  &skq LSFT NAV_SPACE
            >;
        };


        layer_Number{
            bindings = <
                &none        &kp F1        &kp F2        &kp F3        &kp F4         &kp F5                                                 &kp F6     &kp F7      &kp F8        &kp F9          &kp F10        &kp F11
               &trans     &kp SLASH        &kp N9        &kp N8        &kp N7       &kp STAR                                               &kp BSLH   &kp HASH      &kp AMPS      &kp PIPE     &kp TILDE           &kp F12
               &trans     &kp MINUS        &kp N6        &kp N5        &kp N4       &kp PLUS                                                 &kp AT     &trans      &kp LALT      &kp LCTL      &kp LSFT     &kp KP_NUM
 &magic LAYER_Magic 0         &kp X        &kp N3        &kp N2        &kp N1      &kp PRCNT                                              &kp CARET     &kp N8      &kp COMMA     &kp DOT      &kp SLASH &to LAYER_Base
                                      &none     &trans     &trans                                                                        &kp KP_N0  &kp KP_DOT      &kp BSPC
                                                            &kp N0  &kp LT &kp GT                                         &kp LT LOCK_NUM  &kp SPACE
            >;
        };

        layer_NumTmp {
            TRANSPARENT_LAYER  
        };
        
        layer_NumLck {
            TRANSPARENT_LAYER  
        };
        
        layer_Navigation {
            bindings = <
              &kp INS     &kp F1     &kp F2      &kp F3     &kp F4     &kp F5                                       &kp F6    &kp F7           &kp F8       &kp F9          &kp F10    &kp F11
             &kp SLCK   &swapper  &kp HOME      &kp UP    &kp END  &kp PG_UP                                    &kp PG_UP  &kp BSPC           &kp UP      &kp DEL         &kp K_APP    &kp F12
             &kp CAPS  &skq LSFT  &skq LCTL   &skq LALT  &skq LGUI  &kp PG_DN                                   &kp PG_DN  &kp LEFT         &kp DOWN    &kp RIGHT  &kp PAUSE_BREAK  &kp PSCRN
 &magic LAYER_Magic 0  &skq LSFT  &skq LCTL   &skq LALT  &skq LGUI   &kp RBRC                                     &kp AMPS  &kp STAR        &kp UNDER     &kp PLUS        &kp LSHFT  &kp LCTRL
                                  &kp CARET      &trans     &trans                                                            &trans  &kp LC(LS(TAB))  &kp LC(TAB)
                                                            &to LAYER_Base  &trans  &trans       &trans  LOCK_NAV &trans
            >;
        };

        layer_NavTemp {
            TRANSPARENT_LAYER  
        };

        layer_NavLock {
            TRANSPARENT_LAYER  
        };
        
        
        layer_Symbol {
            bindings = <
              &kp INS     &kp F1     &kp F2      &kp F3     &kp F4     &kp F5                                       &kp F6    &kp F7           &kp F8       &kp F9          &kp F10    &kp F11
             &kp SLCK  &kp GRAVE     &kp LT      &kp GT  &kp MINUS   &kp PIPE                                      &kp CARET &kp LBRC         &kp RBRC   &kp DOLLAR            ARROW &kp F12
             &kp CAPS   &kp EXCL   &kp STAR   &kp SLASH  &kp EQUAL   &kp AMPS                                      &kp HASH  &kp LPAR         &kp RPAR     &kp SCLN           &kp DQT  &kp PSCRN
 &magic LAYER_Magic 0  &kp TILDE   &kp PLUS    &kp LBKT   &kp RBKT  &kp PRCNT                                      &kp AT    &kp COLON       &kp COMMA      &kp DOT           &kp SQT  &kp LCTRL
                                  &kp CARET      &trans     &trans                                                            &trans  &kp LC(LS(TAB))  &kp LC(TAB)
                                                            &to LAYER_Base  &trans  &trans       &trans  &trans  &trans
            >;
        };
        layer_Always {
            bindings = <
              &kp INS     &kp F1       &kp F2      &kp F3     &kp F4     &kp F5                                       &kp F6    &kp F7           &kp F8       &kp F9          &kp F10    &kp F11
             &kp SLCK   &swapper      &kp TAB   &kp COLON    &kp ESC   &kp PIPE                                      &kp CARET &kp LBRC         &kp RBRC   &kp DOLLAR            &arrow  &kp F12
             &kp CAPS  &overview  &kp PERCENT   &kp SLASH  &kp ENTER   &kp AMPS                                      &kp HASH  &kp RCTL         &kp RSFT     &kp LALT         &kp RGUI  &kp PSCRN
 &magic LAYER_Magic 0  &kp TILDE     &kp PLUS    &kp LBKT   &kp RBKT  &kp PRCNT                                      &kp AT    &kp COLON       &kp COMMA      &kp DOT         &kp SQT  &kp LCTRL
                                    &kp CARET      &trans     &trans                                                            &trans  &kp LC(LS(TAB))  &kp LC(TAB)
                                                            &to LAYER_Base  &trans  &trans       &trans  &trans  &trans
            >;
        };

        layer_Magic {
            bindings = <
  &bt BT_CLR     &kp C_BRI_DN     &kp C_BRI_UP       &kp C_PREV       &kp C_NEXT         &kp C_PP                                &kp C_MUTE  &kp C_VOL_DN  &kp C_VOL_UP   &none   &none    &bt BT_CLR_ALL
 &bootloader  &rgb_ug RGB_SPI  &rgb_ug RGB_SAI  &rgb_ug RGB_HUI  &rgb_ug RGB_BRI  &rgb_ug RGB_TOG                                     &none         &none         &none   &none   &none       &bootloader
  &sys_reset  &rgb_ug RGB_SPD  &rgb_ug RGB_SAD  &rgb_ug RGB_HUD  &rgb_ug RGB_BRD  &rgb_ug RGB_EFF                                     &none         &none         &none   &none   &none        &sys_reset
       &none            &none            &bt_0            &bt_1            &bt_2            &bt_3                                     &none         &none         &none   &none   &none &to LAYER_Factory
                                  &out OUT_USB            &none            &none                                                                    &none         &none   &none
                                                                                            &none   &none   &none     &none   &none   &none
            >;
        };

        layer_Factory {
            bindings = <
 &kp N0  &kp N4  &kp N8  &kp N3  &kp N8  &kp N3                                       &kp N3  &kp N8  &kp N3  &kp N8  &kp N4  &kp N0
 &kp N1  &kp N5  &kp N9  &kp N4  &kp N9  &kp N4                                       &kp N4  &kp N9  &kp N4  &kp N9  &kp N5  &kp N1
 &kp N2  &kp N6  &kp N0  &kp N5  &kp N0  &kp N5                                       &kp N5  &kp N0  &kp N5  &kp N0  &kp N6  &kp N2
 &kp N3  &kp N7  &kp N1  &kp N6  &kp N1  &kp N6                                       &kp N6  &kp N1  &kp N6  &kp N1  &kp N7  &kp N3
                 &kp N2  &kp N7  &kp N2                                                       &kp N2  &kp N7  &kp N2
                                          &kp N7  &kp N8  &kp N9      &kp N9  &kp N8  &kp N7
            >;
        };
    };
};

&cirque_rh_listener {
    input-processors = <&zip_xy_scaler 3 1>;
    layer_2 {
        layers = <2>;
        input-processors = <&zip_xy_scaler 9 1>;
    };
};

&cirque_lh_listener {
    input-processors = <&zip_xy_to_scroll_mapper>, <&zip_xy_scaler 1 8>, <&zip_click_to_right_click_mapper>;
    layer_4 {
        layers = <4>;
        input-processors = <&zip_xy_scaler 3 1>;
    };
};
