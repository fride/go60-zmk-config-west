## config/west.yml
```yaml
manifest:
  remotes:
    - name: moergo-sc
      url-base: https://github.com/moergo-sc
    - name: urob
      url-base: https://github.com/urob
  projects:
    - name: zmk
      remote: moergo-sc
      revision: main
      import: app/west.yml
    - name: zmk-adaptive-key
      remote: urob
      revision: main # set to same as ZMK version above
    - name: zmk-helpers
      remote: urob
      revision: main # set to same as ZMK version above
    - name: zmk-leader-key
      remote: urob
      revision: main
    - name: zmk-auto-layer
      remote: urob
      revision: main
    - name: zmk-tri-state
      remote: urob
      revision: main
    - name: zmk-unicode
      remote: urob
      revision: main
  self:
    path: config
```
